## module_config/module_esp8266_1mb/sdkconfig.defaults
```kconfig
# The Optimized Configuration
# Do NOT edit unless you know exactly what you are doing


CONFIG_IDF_TARGET_ESP8266=y


# Serial flasher config
CONFIG_ESPTOOLPY_FLASHMODE_DOUT=y
CONFIG_ESPTOOLPY_FLASHMODE="dout"
CONFIG_ESPTOOLPY_FLASHFREQ_80M=y
CONFIG_ESPTOOLPY_FLASHFREQ="80m"
CONFIG_ESPTOOLPY_FLASHSIZE_1MB=y
CONFIG_ESPTOOLPY_MONITOR_BAUD_115200B=y


# Partition Table
CONFIG_PARTITION_TABLE_CUSTOM=y
CONFIG_PARTITION_TABLE_CUSTOM_FILENAME="module_config/module_esp8266_1mb/partitions_at.csv"
CONFIG_PARTITION_TABLE_FILENAME="module_config/module_esp8266_1mb/partitions_at.csv"
CONFIG_COMPILER_OPTIMIZATION_LEVEL_DEBUG=y


# PHY
CONFIG_ESP_PHY_INIT_DATA_IN_PARTITION=n
CONFIG_ESP8266_PHY_MAX_WIFI_TX_POWER=21


# AT Customized Partitions
CONFIG_AT_CUSTOMIZED_PARTITION_TABLE_FILE="module_config/module_esp8266_1mb/at_customize.csv"
CONFIG_AT_CUSTOMIZED_PARTITION_TABLE_OFFSET=0x18000


# ESP8266-specific
CONFIG_ESP8266_DEFAULT_CPU_FREQ_160=y
CONFIG_ESP8266_DEFAULT_CPU_FREQ_MHZ=160


# Common ESP-related
CONFIG_ESP_ERR_TO_NAME_LOOKUP=n
CONFIG_ESP_CONSOLE_UART_CUSTOM=y
CONFIG_ESP_CONSOLE_UART_CUSTOM_NUM_1=y
CONFIG_ESP_CONSOLE_UART_NUM=1

# AT port for ESP-01
CONFIG_AT_BASE_ON_UART=y
CONFIG_AT_UART_DEFAULT_FLOW_CONTROL=0
```
